## tools/device-provisioner/sdkconfig.defaults
```kconfig
CONFIG_APP_BUILD_TYPE_RAM=y
CONFIG_COMPILER_OPTIMIZATION_SIZE=y
CONFIG_LOG_DEFAULT_LEVEL_NONE=y
CONFIG_LOG_MAXIMUM_LEVEL=0
CONFIG_BOOTLOADER_LOG_LEVEL_NONE=y
CONFIG_ESP_SYSTEM_PANIC_SILENT_REBOOT=y
CONFIG_ESP_CONSOLE_UART_BAUDRATE=115200
CONFIG_NEWLIB_NANO_FORMAT=y
CONFIG_ESP_MAIN_TASK_STACK_SIZE=16384
CONFIG_FREERTOS_HZ=1000
CONFIG_MBEDTLS_HKDF_C=y
CONFIG_MBEDTLS_TLS_DISABLED=y
CONFIG_PARTITION_TABLE_OFFSET=0x8000
CONFIG_ESP_SYSTEM_ESP32_SRAM1_REGION_AS_IRAM=y
```

## tools/notification-provisioner/sdkconfig.defaults
```kconfig
CONFIG_IDF_TARGET="esp32"
CONFIG_APP_BUILD_TYPE_RAM=y
# CONFIG_APP_BUILD_TYPE_PURE_RAM_APP is not set
CONFIG_COMPILER_OPTIMIZATION_SIZE=y
CONFIG_LOG_DEFAULT_LEVEL_NONE=y
CONFIG_LOG_MAXIMUM_LEVEL=0
CONFIG_BOOTLOADER_LOG_LEVEL_NONE=y
CONFIG_ESP_SYSTEM_PANIC_SILENT_REBOOT=y
CONFIG_ESP_CONSOLE_UART_BAUDRATE=115200
CONFIG_NEWLIB_NANO_FORMAT=y
# CONFIG_ESP_DEBUG_STUBS_ENABLE is not set
CONFIG_ESP_ERR_TO_NAME_LOOKUP=n
CONFIG_ESP_MAIN_TASK_STACK_SIZE=12288
CONFIG_FREERTOS_UNICORE=y
CONFIG_FREERTOS_HZ=1000
CONFIG_ESP_SYSTEM_ESP32_SRAM1_REGION_AS_IRAM=y
CONFIG_MBEDTLS_HKDF_C=y
CONFIG_MBEDTLS_TLS_DISABLED=y
# CONFIG_MBEDTLS_SHA1_C is not set
# CONFIG_MBEDTLS_SHA512_C is not set
# CONFIG_MBEDTLS_ECP_DP_SECP192R1_ENABLED is not set
# CONFIG_MBEDTLS_ECP_DP_SECP224R1_ENABLED is not set
# CONFIG_MBEDTLS_ECP_DP_SECP384R1_ENABLED is not set
# CONFIG_MBEDTLS_ECP_DP_SECP521R1_ENABLED is not set
# CONFIG_MBEDTLS_ECP_DP_SECP192K1_ENABLED is not set
# CONFIG_MBEDTLS_ECP_DP_SECP224K1_ENABLED is not set
# CONFIG_MBEDTLS_ECP_DP_SECP256K1_ENABLED is not set
# CONFIG_MBEDTLS_ECP_DP_BP256R1_ENABLED is not set
# CONFIG_MBEDTLS_ECP_DP_BP384R1_ENABLED is not set
# CONFIG_MBEDTLS_ECP_DP_BP512R1_ENABLED is not set
# CONFIG_MBEDTLS_ECP_DP_CURVE25519_ENABLED is not set
CONFIG_PARTITION_TABLE_OFFSET=0x8000
CONFIG_SPI_FLASH_DANGEROUS_WRITE_ABORTS=y
```
